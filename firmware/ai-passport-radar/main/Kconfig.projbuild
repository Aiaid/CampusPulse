## firmware/ai-passport-radar/main/Kconfig.projbuild
```kconfig
menu "CampusPulse application"

config CP_PASSPORT_DISPLAY
    bool "Enable the imported Passport display"
    default y
    help
        Optional display; services do not depend on its availability.
        This profile is ESP32-C3 only. Never use its pins for another board.

config CP_PASSPORT_BUTTONS
    bool "Enable Passport ADC buttons"
    default y

config CP_PASSPORT_REFRESH_MS
    int "Passport normal display interval (milliseconds)"
    range 1000 10000
    default 2000
    help
        Minimum interval between changed normal telemetry frames. Page, setup,
        authentication, collection and new upload/storage failure changes draw
        immediately. Identical views are skipped. This does not change sensor
        sampling or network scheduling.

config CP_LEGACY_RADAR_DIAGNOSTICS
    bool "Run the inherited local-only Radar diagnostics"
    default n
    help
        Starts the inherited scanner without cloud enrollment for explicit local
        diagnostics. It never uploads field data or claims an applied policy.
        Normal boot waits for runtime provisioning and a compatible policy.

endmenu
```

## firmware/components/cp_collect/Kconfig
```kconfig
menu "CampusPulse collector"
config CP_COLLECT_MAX_ADDRESSES
    int "Compiled maximum distinct addresses per window"
    range 1 512
    default 128
    help
        Build ceiling, not a collection policy or a measured radio capacity.
        Larger profiles need separately admitted address/bin banks and physical
        memory, queue and upload acceptance. Default C3 builds retain 128.
endmenu
```

## firmware/components/cp_network/Kconfig
```kconfig
menu "CampusPulse network transport"
config CP_NETWORK_MAX_BATCH_ITEMS
    int "Compiled maximum upload batch items"
    range 4 128
    default 16
    help
        Local item/ACK workspace ceiling. Policy values are clamped to this
        build limit, while the protocol limit remains 128 and bodies stay
        bounded to 8192 bytes. Default C3 workspaces retain 16 items.
config CP_NETWORK_MQTT_WSS
    bool "Use MQTT RPC transport (Cloudflare WSS or native TLS)"
    default y
    select MQTT_PROTOCOL_311
    select MQTT_TRANSPORT_SSL
    select MQTT_TRANSPORT_WEBSOCKET if !CP_NETWORK_MQTT_NATIVE_TLS
    select MQTT_TRANSPORT_WEBSOCKET_SECURE if !CP_NETWORK_MQTT_NATIVE_TLS
    help
        Production transport for contact, configuration, activation and frozen
        ingest RPCs. Disable explicitly only for HTTPS diagnostics. MQTT PUBACK never replaces the
        exact durable Cloudflare application ACK. Physical memory, reconnection
        and capture acceptance are required before enabling a field build.
config CP_NETWORK_MQTT_NATIVE_TLS
    bool "Use native MQTT/TLS with independent broker credentials"
    depends on CP_NETWORK_MQTT_WSS
    default y
    help
        Connect to a native MQTT/TLS broker instead of the Cloudflare WSS
        gateway. The broker needs a separate RPC relay; broker PUBACK does not
        acknowledge Cloudflare persistence. Never reuse a Cloudflare device
        token as the broker password. The existing runtime token is preserved.
config CP_NETWORK_MQTT_WSS_URI
    string "Public gateway WSS URL (no credentials or query)"
    depends on CP_NETWORK_MQTT_WSS && !CP_NETWORK_MQTT_NATIVE_TLS
    default ""
    help
        Set wss://host/mqtt through an external/private sdkconfig override.
        Device bearer credentials still come only from runtime settings.
endmenu
```

## firmware/components/cp_perf/Kconfig
```kconfig
menu "CampusPulse optional profiling"
config CP_PERF_PROFILE
    bool "Log bounded CPU and operation timing samples"
    default n
    depends on FREERTOS_UNICORE && !FREERTOS_SMP
    depends on FREERTOS_GENERATE_RUN_TIME_STATS && FREERTOS_USE_TRACE_FACILITY
    depends on FREERTOS_RUN_TIME_STATS_USING_ESP_TIMER
    help
        Optional evaluation-only statistics, sampled by the existing supervisor
        every ten seconds. Requires explicit FreeRTOS run-time statistics with
        ESP_TIMER; prefer the U64 run-time counter for long observations.
        No new task or heap buffer. Scheduler-suspended lookups are measured.
        Six application-task stack high-water scans add measured suspended
        scheduler work; SDK task stacks are not scanned.
        Runtime statistics add per-task storage and context-switch overhead.
        Operation timings are overlapping wall time, not exclusive CPU time.
endmenu
```

## firmware/components/cp_pipeline/Kconfig
```kconfig
menu "CampusPulse upload scheduling"
config CP_PIPELINE_PSRAM_BANKS
    bool "Allocate collector banks and frozen upload workspaces in PSRAM"
    depends on IDF_TARGET_ESP32S3 && SPIRAM
    default n
    help
        Explicitly allocate both core/bin banks and immutable upload read buffers
        with SPIRAM and 8-bit capabilities, without internal-memory fallback.
        Bank replacement is transactional and occurs only with ingress stopped.
        Disabled boards keep their static core banks and existing allocation path.

config CP_UPLOAD_PREFER_CURRENT_BOOT
    bool "Prefer current-boot batches over historical backlog"
    default n
    help
        Within each stream, keep the oldest pending batch first separately for
        current-boot and historical records. Upload eligible current-boot heads
        before historical heads. Retry-delayed current heads leave capacity for
        history. This does not discard, modify or acknowledge stored bodies.
        Adds one boolean per journal slot; disabled builds retain their existing
        scheduler memory layout and ordering.
endmenu
```

## firmware/components/cp_provision/Kconfig
```kconfig
menu "CampusPulse provisioning"
config CP_PROVISION_USB_ONLY
    bool
    default y
    help
        Compatibility marker: provisioning is permanently physical USB only.
        Collection BLE and normal network Wi-Fi remain independent.
endmenu
```

## firmware/components/cp_v3_transport/Kconfig
```kconfig
config CP_V3_NATIVE_MQTT
    bool "Build native MQTT/TLS for the independent V3 transport"
    default n
    select MQTT_PROTOCOL_311
    select MQTT_TRANSPORT_SSL
    help
        Uses the V3 network owner. The application explicitly selects the transport.
```

## firmware/diagnostics/https-lan/main/Kconfig.projbuild
```kconfig
menu "CampusPulse LAN diagnostic"
config CP_LAN_BLE_LOAD
    bool "Real passive BLE and shared RAM-only aggregation load"
    default n
    depends on BT_NIMBLE_ENABLED && BT_NIMBLE_ROLE_OBSERVER
endmenu
```

## firmware/diagnostics/mqtt-relay/sdkconfig.defaults
```kconfig
CONFIG_IDF_TARGET="esp32c3"
CONFIG_ESPTOOLPY_FLASHSIZE_8MB=y
CONFIG_ESPTOOLPY_HEADER_FLASHSIZE_UPDATE=n
CONFIG_PARTITION_TABLE_CUSTOM=y
CONFIG_PARTITION_TABLE_CUSTOM_FILENAME="partitions.csv"
CONFIG_PARTITION_TABLE_FILENAME="partitions.csv"
CONFIG_ESP_CONSOLE_USB_SERIAL_JTAG=y
CONFIG_ESP_CONSOLE_SECONDARY_NONE=y
CONFIG_ESP_MAIN_TASK_STACK_SIZE=8192
CONFIG_FREERTOS_HZ=1000
CONFIG_BT_ENABLED=n
CONFIG_ESP_WIFI_NVS_ENABLED=n
# Prevent PHY recalibration from writing its separate NVS namespace on boot.
CONFIG_ESP_PHY_CALIBRATION_AND_DATA_STORAGE=n
CONFIG_ESP_WIFI_IRAM_OPT=n
CONFIG_ESP_WIFI_RX_IRAM_OPT=n
CONFIG_ESP_WIFI_STATIC_RX_BUFFER_NUM=6
CONFIG_ESP_WIFI_ENT_FREE_DYNAMIC_BUFFER=y
CONFIG_MQTT_PROTOCOL_311=y
CONFIG_MQTT_TRANSPORT_SSL=y
CONFIG_MQTT_REPORT_DELETED_MESSAGES=y
CONFIG_MQTT_OUTBOX_EXPIRED_TIMEOUT_MS=120000
CONFIG_MBEDTLS_HAVE_TIME=y
CONFIG_MBEDTLS_HAVE_TIME_DATE=y
CONFIG_MBEDTLS_SSL_PROTO_TLS1_2=y
CONFIG_MBEDTLS_SSL_PROTO_TLS1_3=n
CONFIG_MBEDTLS_SSL_IN_CONTENT_LEN=16384
CONFIG_MBEDTLS_SSL_OUT_CONTENT_LEN=4096
CONFIG_MBEDTLS_DYNAMIC_BUFFER=y
CONFIG_MBEDTLS_DYNAMIC_FREE_CONFIG_DATA=n
CONFIG_MBEDTLS_DYNAMIC_FREE_CA_CERT=n
CONFIG_MBEDTLS_HARDWARE_AES=y
CONFIG_MBEDTLS_HARDWARE_SHA=y
CONFIG_MBEDTLS_HARDWARE_MPI=y
CONFIG_ESP_TLS_INSECURE=n
CONFIG_LOG_DEFAULT_LEVEL_NONE=y
CONFIG_LOG_MAXIMUM_EQUALS_DEFAULT=y
CONFIG_BOOTLOADER_LOG_LEVEL_NONE=y
```

## firmware/diagnostics/transport-compare/main/Kconfig.projbuild
```kconfig
menu "CampusPulse transport comparison"
config CP_LAN_BLE_LOAD
    bool "Real passive BLE and RAM-only aggregation load"
    default y
    depends on BT_NIMBLE_ENABLED && BT_NIMBLE_ROLE_OBSERVER
endmenu
```

## firmware/diagnostics/transport-compare/sdkconfig.defaults
```kconfig
CONFIG_IDF_TARGET="esp32c3"
CONFIG_ESPTOOLPY_FLASHSIZE_8MB=y
CONFIG_ESPTOOLPY_HEADER_FLASHSIZE_UPDATE=n
CONFIG_PARTITION_TABLE_CUSTOM=y
CONFIG_PARTITION_TABLE_CUSTOM_FILENAME="partitions.csv"
CONFIG_PARTITION_TABLE_FILENAME="partitions.csv"
CONFIG_ESP_CONSOLE_USB_SERIAL_JTAG=y
CONFIG_ESP_CONSOLE_SECONDARY_NONE=y
CONFIG_ESP_MAIN_TASK_STACK_SIZE=8192
CONFIG_FREERTOS_HZ=1000
CONFIG_ESP_WIFI_NVS_ENABLED=n
# Prevent PHY recalibration from writing its separate NVS namespace on boot.
CONFIG_ESP_PHY_CALIBRATION_AND_DATA_STORAGE=n
CONFIG_ESP_WIFI_IRAM_OPT=n
CONFIG_ESP_WIFI_RX_IRAM_OPT=n
CONFIG_ESP_WIFI_STATIC_RX_BUFFER_NUM=6
CONFIG_ESP_WIFI_ENT_FREE_DYNAMIC_BUFFER=y
CONFIG_MBEDTLS_HAVE_TIME=y
CONFIG_MBEDTLS_HAVE_TIME_DATE=y
CONFIG_MBEDTLS_SSL_PROTO_TLS1_2=y
CONFIG_MBEDTLS_SSL_PROTO_TLS1_3=n
CONFIG_MBEDTLS_SSL_IN_CONTENT_LEN=16384
CONFIG_MBEDTLS_SSL_OUT_CONTENT_LEN=4096
CONFIG_MBEDTLS_DYNAMIC_BUFFER=y
CONFIG_MBEDTLS_DYNAMIC_FREE_CONFIG_DATA=n
CONFIG_MBEDTLS_DYNAMIC_FREE_CA_CERT=n
CONFIG_MBEDTLS_HARDWARE_AES=y
CONFIG_MBEDTLS_HARDWARE_SHA=y
CONFIG_MBEDTLS_HARDWARE_MPI=y
CONFIG_ESP_TLS_INSECURE=n
CONFIG_LOG_DEFAULT_LEVEL_NONE=y
CONFIG_LOG_MAXIMUM_EQUALS_DEFAULT=y
CONFIG_BOOTLOADER_LOG_LEVEL_NONE=y
CONFIG_MBEDTLS_CERTIFICATE_BUNDLE=y
CONFIG_MBEDTLS_CERTIFICATE_BUNDLE_DEFAULT_FULL=y
CONFIG_ESP_TLS_SKIP_SERVER_CERT_VERIFY=n
CONFIG_MBEDTLS_SSL_KEEP_PEER_CERTIFICATE=y
CONFIG_CP_LAN_BLE_LOAD=y
CONFIG_BT_ENABLED=y
CONFIG_BT_NIMBLE_ENABLED=y
CONFIG_BT_NIMBLE_ROLE_CENTRAL=n
CONFIG_BT_NIMBLE_ROLE_PERIPHERAL=n
CONFIG_BT_NIMBLE_ROLE_BROADCASTER=n
CONFIG_BT_NIMBLE_ROLE_OBSERVER=y
CONFIG_BT_NIMBLE_MAX_CONNECTIONS=1
CONFIG_BT_NIMBLE_HOST_BASED_PRIVACY=n
CONFIG_BT_NIMBLE_NVS_PERSIST=n
CONFIG_BT_NIMBLE_SECURITY_ENABLE=n
CONFIG_BT_NIMBLE_MSYS_1_BLOCK_COUNT=6
CONFIG_BT_NIMBLE_MSYS_2_BLOCK_COUNT=8
CONFIG_BT_NIMBLE_TRANSPORT_ACL_FROM_LL_COUNT=6
CONFIG_BT_NIMBLE_TRANSPORT_EVT_COUNT=12
CONFIG_BT_NIMBLE_TRANSPORT_EVT_DISCARD_COUNT=8
CONFIG_BT_CTRL_BLE_MAX_ACT=3
CONFIG_BT_NIMBLE_HOST_TASK_STACK_SIZE=6144
CONFIG_BT_HCI_LOG_DEBUG_EN=n
CONFIG_BT_CTRL_LE_LOG_EN=n
CONFIG_MQTT_PROTOCOL_311=y
CONFIG_MQTT_PROTOCOL_5=n
```

## firmware/t-energy-v3-trial/main/Kconfig.projbuild
```kconfig
menu "CampusPulse bounded T-Energy acceptance"
config TE_SMALL_CLEAR_LEGACY_SCANSTATS
    bool "Maintenance image: delete only the authorized legacy scanstats/devs key"
    default n
    help
        Explicit operator-authorized maintenance image, not a normal runtime
        feature. Verify the existing 12300-byte BLOB read-only, then erase only
        scanstats/devs through the SDK and commit/read back NOT_FOUND. Never
        erase a namespace, partition, other key, or queue. No BLE/Wi-Fi starts.
        After reporting numeric before/after statistics, remain in USB standby.
        Mutually exclusive with the window-reboot checkpoint image.
config TE_SMALL_TEST_HOLD_FIRST_COMMIT
    bool "Hold after the first committed window for normal-reboot acceptance"
    default n
    help
        Explicit physical acceptance image only. Requires max_windows=1. After
        committing/reopening and releasing that exact window, pause capture
        and hold without POST or more NVS writes until a physical reset. The
        next boot recovers the old exact record before registering new work.
        This is a normal-reboot checkpoint, not arbitrary power-loss acceptance.
endmenu
```

## firmware/t-energy-v3-trial/sdkconfig.defaults
```kconfig
CONFIG_IDF_TARGET="esp32s3"
CONFIG_ESPTOOLPY_FLASHSIZE_16MB=y
CONFIG_ESPTOOLPY_FLASHMODE_QIO=y
CONFIG_ESPTOOLPY_HEADER_FLASHSIZE_UPDATE=n
CONFIG_PARTITION_TABLE_CUSTOM=y
CONFIG_PARTITION_TABLE_CUSTOM_FILENAME="partitions.csv"
CONFIG_SPIRAM=y
CONFIG_SPIRAM_MODE_OCT=y
CONFIG_SPIRAM_SPEED_80M=y
CONFIG_SPIRAM_USE_MALLOC=y
CONFIG_COMPILER_OPTIMIZATION_SIZE=y
CONFIG_ESP_CONSOLE_USB_SERIAL_JTAG=y
CONFIG_ESP_CONSOLE_SECONDARY_NONE=y
CONFIG_FREERTOS_HZ=1000
CONFIG_BT_ENABLED=y
CONFIG_BT_NIMBLE_ENABLED=y
CONFIG_BT_NIMBLE_ROLE_CENTRAL=n
CONFIG_BT_NIMBLE_ROLE_PERIPHERAL=n
CONFIG_BT_NIMBLE_ROLE_BROADCASTER=n
CONFIG_BT_NIMBLE_ROLE_OBSERVER=y
CONFIG_BT_NIMBLE_MEM_ALLOC_MODE_EXTERNAL=y
CONFIG_BT_NIMBLE_MEM_ALLOC_MODE_INTERNAL=n
CONFIG_BT_NIMBLE_NVS_PERSIST=n
CONFIG_BT_NIMBLE_SECURITY_ENABLE=n
CONFIG_BT_NIMBLE_50_FEATURE_SUPPORT=y
CONFIG_BT_NIMBLE_EXT_ADV=y
CONFIG_BT_NIMBLE_EXT_SCAN=y
CONFIG_BT_NIMBLE_ENABLE_PERIODIC_ADV=n
CONFIG_BT_NIMBLE_ENABLE_PERIODIC_SYNC=n
CONFIG_BT_NIMBLE_HOST_TASK_STACK_SIZE=6144
CONFIG_LOG_DEFAULT_LEVEL_INFO=y
CONFIG_LOG_MAXIMUM_EQUALS_DEFAULT=y
CONFIG_ESP_COEX_SW_COEXIST_ENABLE=y
CONFIG_MBEDTLS_HAVE_TIME=y
CONFIG_MBEDTLS_HAVE_TIME_DATE=y
CONFIG_MBEDTLS_CERTIFICATE_BUNDLE=y
CONFIG_MBEDTLS_CERTIFICATE_BUNDLE_DEFAULT_FULL=y
CONFIG_MBEDTLS_DYNAMIC_BUFFER=y
CONFIG_MBEDTLS_SSL_IN_CONTENT_LEN=16384
CONFIG_MBEDTLS_SSL_OUT_CONTENT_LEN=4096
CONFIG_MBEDTLS_EXTERNAL_MEM_ALLOC=y
CONFIG_MBEDTLS_INTERNAL_MEM_ALLOC=n
CONFIG_ESPTOOLPY_FLASHFREQ_80M=y
```

## firmware/waveshare-raw/main/Kconfig.projbuild
```kconfig
menu "Waveshare raw experimental adapters"
config RAW_USB_PROVISION_V2
    bool "Enable experimental existing-v2 USB provisioning after RAW STOP"
    default n
    select MBEDTLS_HAVE_TIME
    select MBEDTLS_HAVE_TIME_DATE
    select MBEDTLS_CERTIFICATE_BUNDLE
    help
        Disabled by default. Bind the existing physical-USB v2 settings flow
        only after an explicit long BOOT or framed begin safely stops recording.
        Network validation and local NVS save run on a separate worker.
        Boot never auto-connects; no TF upload, v3 mode or cloud activation is
        implemented. Battery/display and recording remain on their own paths.
endmenu
```

## firmware/waveshare-raw/sdkconfig.defaults
```kconfig
CONFIG_IDF_TARGET="esp32s3"
CONFIG_ESPTOOLPY_FLASHSIZE_8MB=y
CONFIG_ESPTOOLPY_FLASHMODE_DIO=y
CONFIG_ESPTOOLPY_HEADER_FLASHSIZE_UPDATE=n
CONFIG_PARTITION_TABLE_CUSTOM=y
CONFIG_PARTITION_TABLE_CUSTOM_FILENAME="partitions.csv"
CONFIG_SPIRAM=y
CONFIG_SPIRAM_MODE_OCT=y
CONFIG_SPIRAM_SPEED_80M=y
CONFIG_SPIRAM_USE_MALLOC=y
CONFIG_COMPILER_OPTIMIZATION_SIZE=y
CONFIG_ESP_CONSOLE_USB_SERIAL_JTAG=y
CONFIG_ESP_CONSOLE_SECONDARY_NONE=y
CONFIG_FREERTOS_HZ=1000
CONFIG_FATFS_LFN_HEAP=y
CONFIG_FATFS_MAX_LFN=128
CONFIG_FATFS_FS_LOCK=5
CONFIG_BT_ENABLED=y
CONFIG_BT_NIMBLE_ENABLED=y
CONFIG_BT_NIMBLE_ROLE_CENTRAL=n
CONFIG_BT_NIMBLE_ROLE_PERIPHERAL=n
CONFIG_BT_NIMBLE_ROLE_BROADCASTER=n
CONFIG_BT_NIMBLE_ROLE_OBSERVER=y
CONFIG_BT_NIMBLE_NVS_PERSIST=n
CONFIG_BT_NIMBLE_SECURITY_ENABLE=n
CONFIG_BT_NIMBLE_50_FEATURE_SUPPORT=y
CONFIG_BT_NIMBLE_EXT_ADV=y
CONFIG_BT_NIMBLE_EXT_SCAN=y
CONFIG_BT_NIMBLE_ENABLE_PERIODIC_ADV=n
CONFIG_BT_NIMBLE_ENABLE_PERIODIC_SYNC=n
CONFIG_BT_NIMBLE_HOST_TASK_STACK_SIZE=6144
CONFIG_LOG_DEFAULT_LEVEL_INFO=y
CONFIG_LOG_MAXIMUM_EQUALS_DEFAULT=y
CONFIG_LV_COLOR_DEPTH_8=y
CONFIG_LV_USE_DRAW_SW=y
CONFIG_LV_DRAW_SW_SUPPORT_L8=y
CONFIG_LV_FONT_MONTSERRAT_12=y
CONFIG_LV_FONT_MONTSERRAT_10=y
CONFIG_LV_FONT_MONTSERRAT_14=y
CONFIG_LV_FONT_MONTSERRAT_18=y
CONFIG_LV_FONT_MONTSERRAT_28=y
CONFIG_LV_BUILD_EXAMPLES=n
CONFIG_LV_USE_DEMO_WIDGETS=n
CONFIG_LV_USE_THEME_DEFAULT=n
CONFIG_LV_OS_NONE=y
CONFIG_LV_USE_LABEL=y
```
